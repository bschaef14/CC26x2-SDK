/**
 * Import the modules used in this configuration.
 */
const Board             = scripting.addModule("/ti/drivers/Board");
const Power             = scripting.addModule("/ti/drivers/Power");
const RTOS              = scripting.addModule("/ti/drivers/RTOS");
const LoggerBuf         = scripting.addModule("/ti/loggers/utils/LoggerBuf", {}, false);
const LoggerBuf1        = LoggerBuf.addInstance();
const LoggerITM         = scripting.addModule("/ti/loggers/drivers/LoggerITM", {}, false);
const LoggerITM1        = LoggerITM.addInstance();
const tiUtilsRtos       = scripting.addModule("/ti/utils/RTOS");
const LogMain           = scripting.addModule("/ti/utils/runtime/LogMain");
const LogSite           = scripting.addModule("/ti/utils/runtime/LogSite", {}, false);
const LogSite1          = LogSite.addInstance();
const ITM               = scripting.addModule("/ti/drivers/ITM");
// @cliArgs --board /ti/boards/CC1352R1_LAUNCHXL

/**
 * Select the RTOS flavor. The first line sets a variable in TI Drivers
 * The second pulls in the correct OSAL which is used by logging
 */
RTOS.name = "TI-RTOS";
tiUtilsRtos.name = "TI-RTOS";

/* Add a GPIO instance to force PIN_init() to be called.  We need to
 * call PIN_init() before shutting down the external flash in
 * Board_initHook().
 */
var board = system.deviceData.board.name;
if (board.match(/CC13.2|CC26.2/)) {
    var GPIO = scripting.addModule("/ti/drivers/GPIO");
    var gpio = GPIO.addInstance();
    gpio.$hardware = system.deviceData.board.components.LED0;
    gpio.$name = "CONFIG_GPIO_LED_0";
    gpio.initialOutputState = "High";

    /* assign the ITM to the LaunchPad default */
    ITM.swoPin.$assign  = "DIO18";
}

/**
 * Configure LogMain and the LoggerBuf instance
 */
LogMain.LogSite.logger = LoggerBuf1;
LoggerBuf1.$name       = "CONFIG_ti_loggers_utils_LoggerBuf_Main";
LoggerBuf1.label       = "Main Logger";

/**
 * Configure a second logmodule
 */
LogSite1.module = "ti_utils_examples_app";
LogSite1.loggerMod = "/ti/loggers/drivers/LoggerITM";
LoggerITM1.$name = "CONFIG_ti_loggers_drivers_LoggerITM_0";
LogSite1.logger  = LoggerITM1;
