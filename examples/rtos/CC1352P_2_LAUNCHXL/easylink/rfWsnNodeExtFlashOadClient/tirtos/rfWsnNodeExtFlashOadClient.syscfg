/*
 * Copyright (c) 2018, Texas Instruments Incorporated
 * All rights reserved.
 *
 * Redistribution and use in source and binary forms, with or without
 * modification, are permitted provided that the following conditions
 * are met:
 *
 * *  Redistributions of source code must retain the above copyright
 *    notice, this list of conditions and the following disclaimer.
 *
 * *  Redistributions in binary form must reproduce the above copyright
 *    notice, this list of conditions and the following disclaimer in the
 *    documentation and/or other materials provided with the distribution.
 *
 * *  Neither the name of Texas Instruments Incorporated nor the names of
 *    its contributors may be used to endorse or promote products derived
 *    from this software without specific prior written permission.
 *
 * THIS SOFTWARE IS PROVIDED BY THE COPYRIGHT HOLDERS AND CONTRIBUTORS "AS IS"
 * AND ANY EXPRESS OR IMPLIED WARRANTIES, INCLUDING, BUT NOT LIMITED TO,
 * THE IMPLIED WARRANTIES OF MERCHANTABILITY AND FITNESS FOR A PARTICULAR
 * PURPOSE ARE DISCLAIMED. IN NO EVENT SHALL THE COPYRIGHT OWNER OR
 * CONTRIBUTORS BE LIABLE FOR ANY DIRECT, INDIRECT, INCIDENTAL, SPECIAL,
 * EXEMPLARY, OR CONSEQUENTIAL DAMAGES (INCLUDING, BUT NOT LIMITED TO,
 * PROCUREMENT OF SUBSTITUTE GOODS OR SERVICES; LOSS OF USE, DATA, OR PROFITS;
 * OR BUSINESS INTERRUPTION) HOWEVER CAUSED AND ON ANY THEORY OF LIABILITY,
 * WHETHER IN CONTRACT, STRICT LIABILITY, OR TORT (INCLUDING NEGLIGENCE OR
 * OTHERWISE) ARISING IN ANY WAY OUT OF THE USE OF THIS SOFTWARE,
 * EVEN IF ADVISED OF THE POSSIBILITY OF SUCH DAMAGE.
 */
// @cliArgs --board /ti/boards/CC1352P_2_LAUNCHXL

/*
 *  rfWsnNodeExtFlashOadClient.syscfg
 */

/* ======== RF ======== */
var RF = scripting.addModule("/ti/drivers/RF");

/* if an antenna component exists, assign it to the rf instance */
if (system.deviceData.board && system.deviceData.board.components.RF) {
    RF.$hardware = system.deviceData.board.components.RF;
}

/* ======== LED Red ======== */
var GPIO = scripting.addModule("/ti/drivers/GPIO");  // Add a GPIO module for use by LEDs
var LED_R = GPIO.addInstance();                      // Add an a GPIO module instance for LED_R

/* if a red LED component exists, assign it to the LED_R instance */
if (system.deviceData.board && system.deviceData.board.components.LED_RED) {
    LED_R.$hardware = system.deviceData.board.components.LED_RED;
}
else
{
    LED_R.mode = "Output";  // Set the LED pin to output
}

LED_R.mode = "Dynamic";                              // Change the GPIO to Dynamic mode
LED_R.pinInstance.mode = "Output";                   // Ensure the pin is in output mode
LED_R.$name = "CONFIG_GPIO_RLED";                     // Descriptive name for the LED_R GPIO
LED_R.pinInstance.$name = "CONFIG_PIN_RLED";          // Descriptive name for LED_R PIN

/* ======== Left Button ======== */
var GPIO = scripting.addModule("/ti/drivers/GPIO");  // Add a GPIO module for use by buttons
var BUTTON_L = GPIO.addInstance();                      // Add an a GPIO module instance for BUTTON_L

/* if a BUTTON0 component exists, assign it to the BUTTON_L instance */
if (system.deviceData.board && system.deviceData.board.components.BUTTON0) {
    BUTTON_L.$hardware = system.deviceData.board.components.BUTTON0;
}

BUTTON_L.mode = "Dynamic";                            // Change the GPIO to Dynamic mode
BUTTON_L.pinInstance.mode = "Input";                  // Ensure the pin is in input mode
BUTTON_L.$name = "CONFIG_GPIO_BTN1";                // Descriptive name for the BUTTON_L GPIO
BUTTON_L.pull = "Pull Up";                            // Use Pull up resistor
BUTTON_L.interruptTrigger = "Falling Edge";           // GPIO Interrupt Trigger
BUTTON_L.callbackFunction = "NULL";                   // Callback function
BUTTON_L.pinInstance.irq = "Falling Edge";            // PIN Interrupt Trigger
BUTTON_L.pinInstance.$name = "CONFIG_PIN_BTN1";     // Descriptive name for the BUTTON_L PIN

/* ======== UART Display ======== */
var Display = scripting.addModule("/ti/display/Display");
var Display_UART = Display.addInstance();

/* if a XDS110UART component exists, assign it to the Display_UART instance */
if (system.deviceData.board && system.deviceData.board.components.XDS110UART) {
    Display_UART.$hardware = system.deviceData.board.components.XDS110UART;
}

Display_UART.$name = "CONFIG_DISPLAY";
Display_UART.uart.$name = "CONFIG_DISPLAY_UART";
Display_UART.uart.txPinInstance.$name = "CONFIG_PIN_UART_TX";  // Descriptive name for UART TX PIN
Display_UART.uart.rxPinInstance.$name = "CONFIG_PIN_UART_RX";  // Descriptive name for UART RX PIN

/* ======== Right Button ======== */
var GPIO = scripting.addModule("/ti/drivers/GPIO");  // Add a GPIO module for use by buttons
var BUTTON_R = GPIO.addInstance();                   // Add an a GPIO module instance for BUTTON_R

/* if a BUTTON1 component exists, assign it to the BUTTON_R instance */
if (system.deviceData.board && system.deviceData.board.components.BUTTON1) {
    BUTTON_R.$hardware = system.deviceData.board.components.BUTTON1;
}

BUTTON_R.mode = "Dynamic";                            // Change the GPIO to Dynamic mode
BUTTON_R.pinInstance.mode = "Input";                  // Ensure the pin is in input mode
BUTTON_R.$name = "CONFIG_GPIO_BTN2";                // Descriptive name for the BUTTON_R GPIO
BUTTON_R.pull = "Pull Up";                            // Use Pull up resistor
BUTTON_R.interruptTrigger = "Falling Edge";           // GPIO Interrupt Trigger
BUTTON_R.callbackFunction = "NULL";                   // Callback function
BUTTON_R.pinInstance.irq = "Falling Edge";            // PIN Interrupt Trigger
BUTTON_R.pinInstance.$name = "CONFIG_PIN_BTN2";     // Descriptive name for the BUTTON_R PIN

/* ======== NVS ======== */
var NVS = scripting.addModule("/ti/drivers/NVS");
var NVS_external = NVS.addInstance();

/* if a SPI_FLASH component exists, assign it to the NVS_external instance */
if (system.deviceData.board && system.deviceData.board.components.SPI_FLASH) {
    NVS_external.$hardware = system.deviceData.board.components.SPI_FLASH;

    var NVSSPI25XDevice1 = NVS_external.externalFlash.spiFlashDevice;
    NVSSPI25XDevice1.$name = "CONFIG_NVS_SPI_0";
    NVSSPI25XDevice1.slaveSelectGpioInstance.mode = "Output";
    NVSSPI25XDevice1.slaveSelectGpioInstance.$name = "CONFIG_GPIO_SPI_FLASH_CS";
    var SPI1 = NVSSPI25XDevice1.sharedSpiInstance;
    SPI1.$name = "Board_SPI_0";
    NVS_external.externalFlash.regionSize = 0x100000;
    NVS_external.externalFlash.verifyBufferSize = 64;
}

NVS_external.$name = "Board_NVSEXTERNAL";

/* ======== RF Design ======== */
var rfDesign = scripting.addModule("ti/devices/radioconfig/rfdesign");
const rfDesignSettings = system.getScript("/ti/common/lprf_rf_design_settings.js").rfDesignSettings;
for(var setting in rfDesignSettings)
{
    rfDesign[setting] = rfDesignSettings[setting];
}

/* ======== EasyLink Stack ======== */
var EasyLink = scripting.addModule("/ti/easylink/easylink");

EasyLink.asyncRxTimeout = 20;
if(rfDesignSettings.rfDesign !== undefined)
{
    EasyLink.rfDesign = rfDesignSettings.rfDesign;
}
EasyLink.enableOad = true;
EasyLink.enableWsnMode = true;

/* ======== Device ======== */
var device = scripting.addModule("ti/devices/CCFG");
const ccfgSettings = system.getScript("/ti/common/lprf_ccfg_settings.js").ccfgSettings;
for(var setting in ccfgSettings)
{
    device[setting] = ccfgSettings[setting];
}

// Can't configure CCFG from OAD project. BIM controls this portion of flash
device.enableCodeGeneration = false;

/* ======== RTOS ======== */
const RTOS = scripting.addModule("/ti/drivers/RTOS");
RTOS.name = "TI-RTOS";
