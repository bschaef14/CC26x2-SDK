/*
 * Copyright (c) 2018, Texas Instruments Incorporated
 * All rights reserved.
 *
 * Redistribution and use in source and binary forms, with or without
 * modification, are permitted provided that the following conditions
 * are met:
 *
 * *  Redistributions of source code must retain the above copyright
 *    notice, this list of conditions and the following disclaimer.
 *
 * *  Redistributions in binary form must reproduce the above copyright
 *    notice, this list of conditions and the following disclaimer in the
 *    documentation and/or other materials provided with the distribution.
 *
 * *  Neither the name of Texas Instruments Incorporated nor the names of
 *    its contributors may be used to endorse or promote products derived
 *    from this software without specific prior written permission.
 *
 * THIS SOFTWARE IS PROVIDED BY THE COPYRIGHT HOLDERS AND CONTRIBUTORS "AS IS"
 * AND ANY EXPRESS OR IMPLIED WARRANTIES, INCLUDING, BUT NOT LIMITED TO,
 * THE IMPLIED WARRANTIES OF MERCHANTABILITY AND FITNESS FOR A PARTICULAR
 * PURPOSE ARE DISCLAIMED. IN NO EVENT SHALL THE COPYRIGHT OWNER OR
 * CONTRIBUTORS BE LIABLE FOR ANY DIRECT, INDIRECT, INCIDENTAL, SPECIAL,
 * EXEMPLARY, OR CONSEQUENTIAL DAMAGES (INCLUDING, BUT NOT LIMITED TO,
 * PROCUREMENT OF SUBSTITUTE GOODS OR SERVICES; LOSS OF USE, DATA, OR PROFITS;
 * OR BUSINESS INTERRUPTION) HOWEVER CAUSED AND ON ANY THEORY OF LIABILITY,
 * WHETHER IN CONTRACT, STRICT LIABILITY, OR TORT (INCLUDING NEGLIGENCE OR
 * OTHERWISE) ARISING IN ANY WAY OUT OF THE USE OF THIS SOFTWARE,
 * EVEN IF ADVISED OF THE POSSIBILITY OF SUCH DAMAGE.
 */
// @cliArgs --board /ti/boards/CC1352P_4_LAUNCHXL

/*
 *  rfWsnConcentrator.syscfg
 */

/* ======== BoosterPack(s) ======== */
// BoosterPacks must be at the top of the .syscfg file
// Check if there is a board before adding display info for the Sharp 96x96 LCD
if (system.deviceData.board)
{
    var BOOSTXL_SHARP128 = scripting.addHardware("/ti/boards/boosterpacks/BOOSTXL-SHARP128");
}

/* ======== RF ======== */
var RF = scripting.addModule("/ti/drivers/RF");

/* if an antenna component exists, assign it to the rf instance */
if (system.deviceData.board && system.deviceData.board.components.RF) {
    RF.$hardware = system.deviceData.board.components.RF;
}

/* ======== LED Red ======== */
var GPIO = scripting.addModule("/ti/drivers/GPIO");  // Add a GPIO module for use by LEDs
var LED_R = GPIO.addInstance();                      // Add an a GPIO module instance for LED_R

/* if a red LED component exists, assign it to the LED_R instance */
if (system.deviceData.board && system.deviceData.board.components.LED_RED) {
    LED_R.$hardware = system.deviceData.board.components.LED_RED;
}
else
{
    LED_R.mode = "Output";  // Set the LED pin to output
}

LED_R.mode = "Dynamic";                              // Change the GPIO to Dynamic mode
LED_R.pinInstance.mode = "Output";                   // Ensure the pin is in output mode
LED_R.$name = "CONFIG_GPIO_RLED";                     // Descriptive name for the LED_R GPIO
LED_R.pinInstance.$name = "CONFIG_PIN_RLED";          // Descriptive name for LED_R PIN

/* ======== LED Green ======== */
var GPIO = scripting.addModule("/ti/drivers/GPIO");  // Add a GPIO module for use by LEDs
var LED_G = GPIO.addInstance();                      // Add an a GPIO module instance for LED_G

/* if a green LED component exists, assign it to the LED_G instance */
if (system.deviceData.board && system.deviceData.board.components.LED_GREEN) {
    LED_G.$hardware = system.deviceData.board.components.LED_GREEN;
}
else
{
    LED_G.mode = "Output";   // Set the LED pin to output
}

LED_G.mode = "Dynamic";                              // Change the GPIO to Dynamic mode
LED_G.pinInstance.mode = "Output";                   // Ensure the pin is in output mode
LED_G.$name = "CONFIG_GPIO_GLED";                     // Descriptive name for the LED_G GPIO
LED_G.pinInstance.$name = "CONFIG_PIN_GLED";          // Descriptive name for LED_G PIN

/* ======== UART Display ======== */
var Display = scripting.addModule("/ti/display/Display");
var Display_UART = Display.addInstance();

/* if a XDS110UART component exists, assign it to the Display_UART instance */
if (system.deviceData.board && system.deviceData.board.components.XDS110UART) {
    Display_UART.$hardware = system.deviceData.board.components.XDS110UART;
}

Display_UART.$name = "CONFIG_DISPLAY";
Display_UART.uart.$name = "CONFIG_DISPLAY_UART";               // Descriptive name for Display_UART
Display_UART.uart.txPinInstance.$name = "CONFIG_PIN_UART_TX";  // Descriptive name for UART TX PIN
Display_UART.uart.rxPinInstance.$name = "CONFIG_PIN_UART_RX";  // Descriptive name for UART RX PIN

/* ======== LCD Display ======== */
// Check if there is a board before adding display info for the Sharp 96x96 LCD
if (system.deviceData.board)
{
    /* Add display module and display instance */
    var Display = scripting.addModule("/ti/display/Display");
    var Display_LCD = Display.addInstance();

    /* Set display to use Sharp LCD hardware */
    Display_LCD.$hardware = BOOSTXL_SHARP128.components.SHARP_LCD_DISPLAY;
    Display_LCD.$name = "CONFIG_DISPLAY_SHARP_LCD";

    /* Setup LCD_ENABLE GPIO and PIN */
    Display_LCD.lcdEnable.$name = "CONFIG_GPIO_LCD_ENABLE";
    Display_LCD.lcdEnable.pinInstance.$name = "CONFIG_PIN_LCD_ENABLE";

    /* Setup LCD_POWER GPIO and PIN */
    Display_LCD.lcdPower.$name = "CONFIG_GPIO_LCD_POWER";
    Display_LCD.lcdPower.pinInstance.$name = "CONFIG_PIN_LCD_POWER";

    /* Setup LCD_CS GPIO and PIN */
    Display_LCD.lcdSS.$name = "CONFIG_GPIO_LCD_SS";
    Display_LCD.lcdSS.pinInstance.$name = "CONFIG_PIN_LCD_SS";

    var SPI_LCD = Display_LCD.spi; // Create reference for Display_LCD SPI setup
    SPI_LCD.sclkPinInstance.$name = "CONFIG_PIN_SPI_CLK";   // Descriptive name for CLK pin
    SPI_LCD.misoPinInstance.$name = "CONFIG_PIN_SPI_MISO";  // Descriptive name for SOMI pin
    SPI_LCD.mosiPinInstance.$name = "CONFIG_PIN_SPI_MOSI";  // Descriptive name for SIMO pin
}

/* ======== RF Design ======== */
var rfDesign = scripting.addModule("ti/devices/radioconfig/rfdesign");
const rfDesignSettings = system.getScript("/ti/common/lprf_rf_design_settings.js").rfDesignSettings;
for(var setting in rfDesignSettings)
{
    rfDesign[setting] = rfDesignSettings[setting];
}

/* ======== EasyLink Stack ======== */
var EasyLink = scripting.addModule("/ti/easylink/easylink");
if(rfDesignSettings.rfDesign !== undefined)
{
    EasyLink.rfDesign = rfDesignSettings.rfDesign;
}
EasyLink.enableAddrFilter = true;
EasyLink.addrFilters = "0x00";
EasyLink.enableWsnMode = true;

/* ======== Device ======== */
var device = scripting.addModule("ti/devices/CCFG");
const ccfgSettings = system.getScript("/ti/common/lprf_ccfg_settings.js").ccfgSettings;
for(var setting in ccfgSettings)
{
    device[setting] = ccfgSettings[setting];
}

/* ======== RTOS ======== */
const RTOS = scripting.addModule("/ti/drivers/RTOS");
RTOS.name = "TI-RTOS";
